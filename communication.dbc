VERSION ""

NS_ :

BS_:

BU_: reciver sender

BO_ 1 UpdateSpeedvalue: 1 sender
 SG_ Updatevalue : 0|1@1- (1,0) [0|0] "" Vector__XXX

BO_ 0 CArSpeedValue: 2 sender
 SG_ distance : 8|8@1- (1,0) [0|100] "meter" Vector__XXX
 SG_ speed : 0|8@1- (1,0) [0|0] "km/hr" Vector__XXX

BA_DEF_  "BusType" STRING ;
BA_DEF_DEF_  "BusType" "CAN";
